## main/Kconfig.projbuild
```kconfig
menu "Kheater Configuration"

    choice
        bool "Mesh Topology"
        default MESH_TOPO_TREE
        help
            Mesh Network Topology.

        config MESH_TOPO_TREE
            bool "MESH_TOPO_TREE"
        config MESH_TOPO_CHAIN
            bool "MESH_TOPO_CHAIN"
    endchoice

    config MESH_TOPOLOGY
        int
        default 0 if MESH_TOPO_TREE
        default 1 if MESH_TOPO_CHAIN
        help
            Mesh Network Topology.

    config MESH_ENABLE_PS
        bool "Enable mesh PS (power save) function"
        default n
        help
            Enable/Disable Power Save function.

    choice
        bool "Mesh PS device duty cycle type"
        depends on MESH_ENABLE_PS
        default MESH_PS_DEV_DUTY_TYPE_REQUEST
        help
            Mesh PS device duty cycle type.

        config MESH_PS_DEV_DUTY_TYPE_REQUEST
            bool "MESH_PS_DEV_DUTY_TYPE_REQUEST"
        config MESH_PS_DEV_DUTY_TYPE_DEMAND
            bool "MESH_PS_DEV_DUTY_TYPE_DEMAND"
    endchoice

    config MESH_PS_DEV_DUTY_TYPE
        int
        depends on MESH_ENABLE_PS
        default 1 if MESH_PS_DEV_DUTY_TYPE_REQUEST
        default 4 if MESH_PS_DEV_DUTY_TYPE_DEMAND
        help
            Mesh PS device duty cycle type.

    config MESH_PS_DEV_DUTY
        int "Mesh PS device duty cycle"
        depends on MESH_ENABLE_PS
        range 1 100
        default 10
        help
            Mesh PS device duty cycle.

    config MESH_PS_NWK_DUTY
        int "Mesh PS network duty cycle"
        depends on MESH_ENABLE_PS
        range 1 100
        default 10
        help
            Mesh PS network duty cycle.

    config MESH_PS_NWK_DUTY_DURATION
        int "Mesh PS network duty cycle duration (unit: minutes)"
        depends on MESH_ENABLE_PS
        range -1 100
        default -1
        help
            Mesh PS network duty cycle duration.

    choice
        bool "Mesh PS network duty cycle rule"
        depends on MESH_ENABLE_PS
        default MESH_PS_NETWORK_DUTY_APPLIED_ENTIRE
        help
            Mesh PS network duty cycle rule.

        config MESH_PS_NETWORK_DUTY_APPLIED_ENTIRE
            bool "MESH_PS_NETWORK_DUTY_APPLIED_ENTIRE"
        config MESH_PS_NETWORK_DUTY_APPLIED_UPLINK
            bool "MESH_PS_NETWORK_DUTY_APPLIED_UPLINK"
    endchoice

    config MESH_PS_NWK_DUTY_RULE
        int
        depends on MESH_ENABLE_PS
        default 0 if MESH_PS_NETWORK_DUTY_APPLIED_ENTIRE
        default 1 if MESH_PS_NETWORK_DUTY_APPLIED_UPLINK
        help
            Mesh PS network duty cycle rule.

    config MESH_MAX_LAYER
        int "Mesh Max Layer"
        range 1 25 if MESH_TOPO_TREE
        range 1 1000 if MESH_TOPO_CHAIN
        default 6
        help
            Max layer allowed in mesh network.

    config MESH_CHANNEL
        int "channel"
        range 0 14
        default 0
        help
            mesh network channel.

    config MESH_ROUTER_SSID
        string "Router SSID"
        help
            Router SSID.

    config MESH_ROUTER_PASSWD
        string "Router password"
        help
            Router password.

    choice
        bool "Mesh AP Authentication Mode"
        default WIFI_AUTH_WPA2_PSK
        help
            Authentication mode.

        config WIFI_AUTH_OPEN
            bool "WIFI_AUTH_OPEN"
        config WIFI_AUTH_WPA_PSK
            bool "WIFI_AUTH_WPA_PSK"
        config WIFI_AUTH_WPA2_PSK
            bool "WIFI_AUTH_WPA2_PSK"
        config WIFI_AUTH_WPA_WPA2_PSK
            bool "WIFI_AUTH_WPA_WPA2_PSK"
    endchoice

    config MESH_AP_AUTHMODE
        int
        default 0 if WIFI_AUTH_OPEN
        default 2 if WIFI_AUTH_WPA_PSK
        default 3 if WIFI_AUTH_WPA2_PSK
        default 4 if WIFI_AUTH_WPA_WPA2_PSK
        help
            Mesh AP authentication mode.

    config MESH_AP_PASSWD
        string "Mesh AP Password"
        help
            Mesh AP password.

    config MESH_AP_CONNECTIONS
        int "Mesh AP Connections"
        range 1 10
        default 6
        help
            The number of mesh stations allowed to connect in.

    config MESH_NON_MESH_AP_CONNECTIONS
        int "Mesh Non Mesh AP Connections"
        range 0 9
        default 0
        help
            The number of non-mesh stations allowed to connect in.

    config MESH_ROUTE_TABLE_SIZE
        int "Mesh Routing Table Size"
        range 1 300
        default 50
        help
            The number of devices over the network(max: 300).

    config KHEATER_MESH_RELAY_ELIGIBLE
        bool "Advertise this firmware as relay eligible"
        default n
        help
            This node may still connect through an ESP-MESH parent. Enabling
            this flag advertises application-level relay eligibility and is
            intentionally disabled for the current rollout.

    menu "Heater Hardware And Safety"

        config KHEATER_FAN_GPIO
            int "Fan GPIO"
            default 13

        config KHEATER_ROTATION_GPIO
            int "Rotation GPIO"
            default 26

        config KHEATER_HEAT_HIGH_GPIO
            int "High heat relay GPIO"
            default 14

        config KHEATER_HEAT_LOW_GPIO
            int "Low heat relay GPIO"
            default 27

        config KHEATER_I2C_SDA_GPIO
            int "OLED I2C SDA GPIO"
            default 21

        config KHEATER_I2C_SCL_GPIO
            int "OLED I2C SCL GPIO"
            default 22

        config KHEATER_I2C_ADDRESS
            hex "SH1106 I2C address"
            default 0x3c

        config KHEATER_COOLDOWN_MS
            int "Fan cooldown time (ms)"
            range 1000 300000
            default 30000

        config KHEATER_AUTO_TEMP_TIMEOUT_MS
            int "AUTO temperature freshness timeout (ms)"
            range 10000 3600000
            default 300000

        config KHEATER_MANUAL_HEAT_LIMIT_MS
            int "Maximum continuous manual heat time (ms)"
            range 60000 28800000
            default 14400000

        config KHEATER_SETPOINT_DEFAULT_X10
            int "Default setpoint in tenths of a degree C"
            range 50 350
            default 267

        config KHEATER_SETPOINT_MIN_X10
            int "Minimum setpoint in tenths of a degree C"
            range -400 800
            default 50

        config KHEATER_SETPOINT_MAX_X10
            int "Maximum setpoint in tenths of a degree C"
            range -400 800
            default 350

        config KHEATER_TEMP_MIN_X10
            int "Minimum accepted external temperature"
            range -1000 1000
            default -400

        config KHEATER_TEMP_MAX_X10
            int "Maximum accepted external temperature"
            range -1000 1500
            default 800

        config KHEATER_HIGH_DELTA_X10
            int "AUTO high-stage threshold below setpoint"
            range 1 100
            default 5

        config KHEATER_DISPLAY_ENABLE
            bool "Enable SH1106 status display"
            default y

        config KHEATER_LOGO_TIME_MS
            int "Boot logo duration (ms)"
            depends on KHEATER_DISPLAY_ENABLE
            range 0 10000
            default 3000

    endmenu
endmenu
```

## sdkconfig.defaults
```kconfig
CONFIG_COMPILER_OPTIMIZATION_SIZE=y
# CONFIG_MESH_ENABLE_PS is not set
CONFIG_ESPTOOLPY_FLASHSIZE_4MB=y
CONFIG_ESPTOOLPY_FLASHSIZE="4MB"
CONFIG_PARTITION_TABLE_CUSTOM=y
CONFIG_PARTITION_TABLE_CUSTOM_FILENAME="partitions.csv"
CONFIG_PARTITION_TABLE_FILENAME="partitions.csv"
CONFIG_BOOTLOADER_APP_ROLLBACK_ENABLE=y
CONFIG_KEEMASH_NODE_V2_LOG_ENABLE=y
# CONFIG_KEEMASH_V2_COMPAT_TUNNEL_ENABLE is not set
CONFIG_KEEMASH_NODE_PSRAM_EXPECTED_BYTES=0
CONFIG_FREERTOS_USE_TRACE_FACILITY=y
CONFIG_FREERTOS_GENERATE_RUN_TIME_STATS=y
CONFIG_KHEATER_DISPLAY_ENABLE=y
# CONFIG_KHEATER_MESH_RELAY_ELIGIBLE is not set
# CONFIG_SPIRAM is not set
```

## sdkconfig.defaults.esp32
```kconfig
CONFIG_IDF_TARGET="esp32"
CONFIG_ESP32_REV_MIN_3=y
CONFIG_ESP32_REV_MIN=3
CONFIG_ESP_DEFAULT_CPU_FREQ_MHZ_240=y
CONFIG_ESP_DEFAULT_CPU_FREQ_MHZ=240
```
